#include <behaviors.dtsi>
#include <dt-bindings/zmk/keys.h>
#include <dt-bindings/zmk/mouse.h>
#include <dt-bindings/zmk/bt.h>
#include <dt-bindings/zmk/ext_power.h>
#include <dt-bindings/zmk/outputs.h>

#include "mouse.dtsi"

#define DEFAULT 0

/ {
    keymap {
        compatible = "zmk,keymap";

        default_layer {
            bindings = <
                 &mkp RCLK
                   &mkp LCLK
                   &kp ENTER
            >;
        };
    };
};
